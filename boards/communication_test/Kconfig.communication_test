## boards/communication_test/Kconfig.communication_test
```kconfig
# Copyright (c) 2020 Intel Corporation
# SPDX-License-Identifier: Apache-2.0

config BOARD_COMMUNICATION_TEST
	bool "Communication Test Board"
	select SOC_STM32F407XE
```

## boards/communication_test/Kconfig.defconfig
```kconfig
# Communication Test board configuration

# Copyright (c) 2020 Intel Corporation
# SPDX-License-Identifier: Apache-2.0

if BOARD_COMMUNICATION_TEST

config SPI_STM32_INTERRUPT
	default y
	depends on SPI

endif # BOARD_COMMUNICATION_TEST
```

## boards/communication_test/board.yml
```yaml
board:
  name: communication_test
  full_name: communication test board 
  vendor: others
  socs:
    - name: stm32f407xx
```

## boards/communication_test/communication_test_defconfig
```kconfig
# Communication Test Board (STM32F407VET6) configuration

# Basic
CONFIG_ARM_MPU=y
CONFIG_FPU=y

# Console / Serial
CONFIG_SERIAL=y
CONFIG_CONSOLE=y
CONFIG_UART_CONSOLE=y

# GPIO
CONFIG_GPIO=y

# Communication peripherals
CONFIG_I2C=y
CONFIG_SPI=y
CONFIG_CAN=y

# Sensor (BMI088 accel + gyro)
CONFIG_SENSOR=y
CONFIG_SENSOR_ASYNC_API=y
CONFIG_BMI08X=y

# ADC
CONFIG_ADC=y

# QDEC (TIM3/TIM4 encoder)
CONFIG_QDEC_STM32=y

# PWM (TIM1)
CONFIG_PWM=y

# USB (OTG FS)
CONFIG_USB_DEVICE_STACK_NEXT=y
# CONFIG_LOG=y
# CONFIG_USBD_LOG_LEVEL_DBG=y
# CONFIG_USBD_LOG_LEVEL_ERR=y

# WS2812 LED strip (via SPI3)
CONFIG_LED_STRIP=y
CONFIG_WS2812_STRIP_SPI=y
```

## boards/nuedc_chassis_slave/Kconfig.defconfig
```kconfig
# STM32F723E DISCOVERY board configuration

# Copyright (c) 2018 Aurelien Jarno
# SPDX-License-Identifier: Apache-2.0

if BOARD_NUEDC_CHASSIS_SLAVE

config SPI_STM32_INTERRUPT
	default y
	depends on SPI


endif # BOARD_NUEDC_CHASSIS_SLAVE
```

## boards/nuedc_chassis_slave/Kconfig.nuedc_chassis_slave
```kconfig
# Copyright (c) 2018 Aurelien Jarno
# SPDX-License-Identifier: Apache-2.0

config BOARD_NUEDC_CHASSIS_SLAVE
	select SOC_STM32F723XX
```

## boards/nuedc_chassis_slave/board.yml
```yaml
board:
  name: nuedc_chassis_slave
  full_name: Nuedc Chassis Slave
  vendor: st
  socs:
    - name: stm32f723xx
```

## boards/nuedc_chassis_slave/nuedc_chassis_slave_defconfig
```kconfig
CONFIG_ARM_MPU=y
CONFIG_HW_STACK_PROTECTION=y
CONFIG_FPU=y
CONFIG_CONSOLE=y

CONFIG_GPIO=y
CONFIG_I2C=y
CONFIG_SPI=y
CONFIG_SPI_STM32_DMA=y
CONFIG_USB_DEVICE_STACK_NEXT=y
CONFIG_CAN=y
CONFIG_SENSOR=y
CONFIG_QDEC_STM32=y
CONFIG_SENSOR_ASYNC_API=y
CONFIG_BMI08X=y
CONFIG_ADC=y
CONFIG_ADC_STM32_DMA=y
CONFIG_SERIAL=y
CONFIG_UART_ASYNC_API=y

# WS2812 LED strip (via SPI3)
CONFIG_LED_STRIP=y
CONFIG_WS2812_STRIP_SPI=y

# IWDG watchdog — 100ms timeout
CONFIG_WATCHDOG=y
CONFIG_IWDG_STM32=y

# PWM (TIM1)
CONFIG_PWM=y
```
